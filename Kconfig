## Kconfig
```kconfig
# Sensor data simulator
#
# Copyright (c) 2019 Nordic Semiconductor
#
# SPDX-License-Identifier: LicenseRef-Nordic-5-Clause
#

config ZMK_SPLIT_BLE_PREF_WEAK_BOND
    bool "Enable split peripheral weak bond"

config ZMK_SPLIT_BLE_PREF_CONTINUOUS_SCAN_WINDOW
    int "Time (in millisecond) to open to continuous scanning"
    default 0
```
